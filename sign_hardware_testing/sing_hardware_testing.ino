#include <Arduino.h>
#include <TensorFlowLite.h>
#include "tensorflow/lite/micro/all_ops_resolver.h"
#include "tensorflow/lite/micro/micro_error_reporter.h"
#include "tensorflow/lite/micro/micro_interpreter.h"
#include "tensorflow/lite/schema/schema_generated.h"
#include "tensorflow/lite/version.h"
#include "sign_model.h" 

const unsigned char test_image_A[] = {
 0x32, 0x32, 0x31, 0x3f, 0x4e, 0x55, 0x3b, 0x27, 0x27, 0x24, 0x25, 0x47,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 0x89
};
 

const unsigned char test_image_B[] = {
  0x2f, 0x2f, 0x31, 0x39, 0x47, 0x4f, 0x40, 0x26, 0x25, 0x23, 0x20, 0x40,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 0x85
};


const unsigned char test_image_C[] = {
  0x73, 0x7b, 0x79, 0x7b, 0x7d, 0x7e, 0x80, 0x97, 0x90, 0x93, 0xe3, 0xfa,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 0xb0
}; 



const unsigned char test_image_Nothing[] =  {
 0x97, 0x8e, 0x85, 0x78, 0x77, 0x73, 0x72, 0x75, 0x73, 0x73, 0x70, 0x6c,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 0xbc
};

const unsigned char test_image_Space[] =  {
  0x56, 0x58, 0x5a, 0x62, 0x66, 0x6a, 0x73, 0x7b, 0x7b, 0xb0, 0xfa, 0xfd,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 0x81
};
// =================================================================


using namespace tflite;

// Globals for TensorFlow
ErrorReporter* error_reporter;
AllOpsResolver resolver;
MicroInterpreter* interpreter;
TfLiteTensor* input;
TfLiteTensor* output;

// Tensor Arena
constexpr int kTensorArenaSize = 30 * 1024; 
static uint8_t tensor_arena[kTensorArenaSize];

// CHANGED: Your class labels updated for 5 classes
const char* kLabels[5] = {"A", "B", "C", "Nothing", "Space"};

// Quantize the image data
void quantize_image(const unsigned char* image_data, TfLiteTensor* in) {
  const float scale = in->params.scale;
  const int zero_point = in->params.zero_point;
  
  for (int i = 0; i < 1024; i++) {
    float f = image_data[i] / 255.0f;
    in->data.int8[i] = (int8_t)((f / scale) + zero_point);
  }
}

void setup() {
  Serial.begin(115200);
  while (!Serial);
  delay(1000);

  // Set up TensorFlow
  static MicroErrorReporter micro_error_reporter;
  error_reporter = &micro_error_reporter;

  // Load the model from the C array
  const Model* tflModel = GetModel(model); // Make sure this name matches your model array in sign_model.h
  if (tflModel->version() != TFLITE_SCHEMA_VERSION) {
    error_reporter->Report("Model version mismatch!");
    return;
  }

  // Set up the interpreter
  static tflite::AllOpsResolver resolver;
  static tflite::MicroInterpreter static_interpreter(tflModel, resolver, tensor_arena, kTensorArenaSize, error_reporter);
  interpreter = &static_interpreter;

  if (interpreter->AllocateTensors() != kTfLiteOk) {
    error_reporter->Report("AllocateTensors() failed.");
    return;
  }

  input = interpreter->input(0);
  output = interpreter->output(0);
  
  error_reporter->Report("Setup complete. Starting test loop...");
}

void loop() {
  // An array of pointers to our test images
  const unsigned char* test_images[] = {
    test_image_A, test_image_B, test_image_C, test_image_Nothing, test_image_Space
  };

  // Loop through each test image
  for (int j = 0; j < 5; j++) {
    error_reporter->Report("\nTesting image '%s'...", kLabels[j]);
    
    // Run inference on the current test image
    quantize_image(test_images[j], input);
    interpreter->Invoke();
    
    const float output_scale = output->params.scale;
    const int output_zero_point = output->params.zero_point;

    Serial.print("  Scores: ");
    for (int i = 0; i < 5; i++) { // CHANGED: Loop for 5 classes
      float probability = (float)(output->data.int8[i] - output_zero_point) * output_scale;
      Serial.print(kLabels[i]);
      Serial.print(": ");
      Serial.print(probability * 100, 1);
      Serial.print("% | ");
    }
    Serial.println();
    
    delay(5000); // Wait 5 seconds before the next test
  }
}